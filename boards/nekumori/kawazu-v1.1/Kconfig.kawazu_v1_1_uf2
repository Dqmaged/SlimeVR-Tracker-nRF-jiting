## boards/nekumori/kawazu-v1.1/Kconfig.kawazu_v1_1_uf2
```kconfig
# Copyright (c) 2024 Nordic Semiconductor ASA
# SPDX-License-Identifier: Apache-2.0

config BOARD_KAWAZU_V1_1_UF2
	select SOC_NRF52833_QIAA
```

## boards/nekumori/kawazu-v1.1/board.yml
```yaml
# Copyright (c) 2024 Nordic Semiconductor ASA
# SPDX-License-Identifier: Apache-2.0

board:
  name: kawazu_v1.1_uf2
  full_name: Kawazu
  vendor: nekumori
  socs:
    - name: nrf52833
```
